## boards/shields/lily58/Kconfig.shield
```kconfig
# Copyright (c) 2020 Pete Johanson
# SPDX-License-Identifier: MIT

config SHIELD_lily58_LEFT
    bool "Enable lily58 Left Shield"
    default $(shields_list_contains,lily58_LEFT)
    help
      Enable support for the left half of the KeyboardZMK split keyboard shield.

config SHIELD_lily58_RIGHT
    bool "Enable lily58 Right Shield"
    default $(shields_list_contains,lily58_RIGHT)
    help
      Enable support for the right half of the lily58 split keyboard shield.
```
